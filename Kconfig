## Kconfig
```kconfig
mainmenu "simple build framework"

source "main/main.config"

config MODULE1
    bool    "Enable Module 1"
    default n

if MODULE1
source "mod1/mod1.config"
endif

config MODULE2
    bool    "Enable Module 2"
    default n

if MODULE2
source "mod2/mod2.config"
endif
```

## test_defconfig
```kconfig
#
# Main Module
#
CONFIG_MAIN_INFO="Hello, Main Module"
# end of Main Module

CONFIG_MODULE1=y
CONFIG_MODULE11=y
# CONFIG_MODULE2 is not set
```
